## config/west.yml
```yaml
manifest:
  remotes:
    - name: zmkfirmware
      url-base: https://github.com/zmkfirmware
    - name: pete-fork
      url-base: https://github.com/petejohanson
  projects:
    - name: zmk
    # uncomment when https://github.com/zmkfirmware/zmk/pull/547 is merged
    # remote: zmkfirmware
      remote: pete-fork
      revision: core/peripheral-behavior-invocation
      import: app/west.yml
  self:
    path: config
```
